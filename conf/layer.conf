## conf/layer.conf
```bitbake
# We have a conf and classes directory, add to BBPATH
BBPATH .= ":${LAYERDIR}"

# We have recipes-* directories, add to BBFILES
BBFILES += "${LAYERDIR}/recipes-*/*/*.bb \
            ${LAYERDIR}/recipes-*/*/*.bbappend"

BBFILE_COLLECTIONS += "mata-chushi"
BBFILE_PATTERN_mata-chushi = "^${LAYERDIR}/"
BBFILE_PRIORITY_mata-chushi = "6"

LAYERDEPENDS_mata-chushi = "core"
# LAYERSERIES_COMPAT_mata-chushi = "kirkstone"
```

## conf/machine/vmachine.conf
```bitbake
# SERIAL_CONSOLES ?= "115200;ttyS0"
# SERIAL_CONSOLES_CHECK = "${SERIAL_CONSOLES}"

PREFERRED_PROVIDER_virtual/kernel ??= "linux-chushi"
PREFERRED_VERSION_linux-chushi ?= "5.15.109"

require conf/machine/include/arm/arch-arm64.inc

KERNEL_IMAGETYPE = "Image"

IMAGE_FSTYPES += "ext4"


DISTRO_FEATURES:remove = "sysvinit"
VIRTUAL-RUNTIME_init_manager ?= "busybox"
VIRTUAL-RUNTIME_login_manager ?= "busybox"
DISTRO_FEATURES_BACKFILL_CONSIDERED += "sysvinit"
VIRTUAL-RUNTIME_dev_manager ?= "busybox-mdev"
```
